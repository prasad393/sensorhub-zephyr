## CMakeLists.txt
```
cmake_minimum_required(VERSION 3.20.0)
find_package(Zephyr REQUIRED HINTS $ENV{ZEPHYR_BASE})
project(test_temp)
target_sources(app PRIVATE src/main.c ../..//drivers/vs_temp.c)
target_include_directories(app PRIVATE ${CMAKE_CURRENT_SOURCE_DIR}/../../include)
```

## prj.conf
```kconfig
CONFIG_ZTEST=y
CONFIG_ZTEST_NEW_API=y
CONFIG_TEST_RANDOM_GENERATOR=y
```

## src/main.c
```c
#include <zephyr/ztest.h>
#include "sensorhub.h"

ZTEST(temp_suite, test_temp_noise_bounds)
{
    struct temp_sample t;
    float last_avg = 0.0f;
    for (int i = 0; i < 200; ++i) {
        zassert_ok(vs_temp_read(&t), "read fail");
        zassert_true(t.celsius > 20.0f && t.celsius < 30.0f, "temp out of bounds");
        last_avg = t.avg;
    }
    zassert_true(last_avg > 20.0f && last_avg < 30.0f, "avg out of bounds");
}

ZTEST_SUITE(temp_suite, NULL, NULL, NULL, NULL, NULL);
```
